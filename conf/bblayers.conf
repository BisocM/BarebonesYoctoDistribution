## conf/bblayers.conf
```bitbake
# POKY_BBLAYERS_CONF_VERSION is increased each time build/conf/bblayers.conf
# changes incompatibly
POKY_BBLAYERS_CONF_VERSION = "2"

BBPATH = "${TOPDIR}"
BBFILES ?= ""

BBLAYERS ?= " \
  /home/vboxuser/yocto/poky/meta \
  /home/vboxuser/yocto/poky/meta-poky \
  /home/vboxuser/yocto/poky/meta-yocto-bsp \
  /home/vboxuser/yocto/meta-openembedded/meta-oe \
  /home/vboxuser/yocto/meta-openembedded/meta-python \
  /home/vboxuser/yocto/meta-openembedded/meta-networking \
  /home/vboxuser/yocto/meta-openembedded/meta-multimedia \
  /home/vboxuser/yocto/meta-openembedded/meta-initramfs \
  /home/vboxuser/yocto/meta-raspberrypi \
  /home/vboxuser/yocto/barebones-layer \
  "
```
